/dts-v1/;

/ {
	model = "Saltmere Harbour Bell Controller";
	compatible = "saltmere,bell-controller", "saltmere,harbour";
	#address-cells = <1>;
	#size-cells = <1>;

	memory@80000000 {
		device_type = "memory";
		reg = <0x80000000 0x10000000>;
	};

	bell@10000000 {
		compatible = "saltmere,bell";
		reg = <0x10000000 0x1000>;
		status = "okay";
	};
};
